/*
*
*	主机服务程序
*
*/
#include "bsp_modbus.h"
#include "timer.h"
#include "bsp_timer4.h"
#include "bsp_usart3.h"
#include <stdio.h>
#include <stdlib.h>
#include <string.h>

extern u8 USART3_RX_BUF[USART3_REC_LEN];     //接收缓冲,最大USART_REC_LEN个字节.
extern volatile u8 modbus_com2_over; //接收完成标志

u8 slaveraddr = 1;			//从机地址 
u8 regstartaddr = 0;		//数据开始储存的地址

extern u8 receCount2;
extern u8 sendCount2;	 
extern u8 sendBuf2[32];
extern u8 sendPosi2;
extern u8 checkoutError2;
extern volatile u8 modbus_com2_over;


const u8 auchCRCHi[] = { 
0x00, 0xC1, 0x81, 0x40, 0x01, 0xC0, 0x80, 0x41, 0x01, 0xC0,0x80, 0x41, 0x00, 0xC1, 0x81, 0x40, 0x01, 0xC0, 0x80, 0x41, 
0x00, 0xC1, 0x81, 0x40, 0x00, 0xC1, 0x81, 0x40, 0x01, 0xC0,0x80, 0x41, 0x01, 0xC0, 0x80, 0x41, 0x00, 0xC1, 0x81, 0x40, 
0x00, 0xC1, 0x81, 0x40, 0x01, 0xC0, 0x80, 0x41, 0x00, 0xC1,0x81, 0x40, 0x01, 0xC0, 0x80, 0x41, 0x01, 0xC0, 0x80, 0x41, 
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0x00, 0xC1, 0x81, 0x40, 0x01, 0xC0, 0x80, 0x41, 0x01, 0xC0,0x80, 0x41, 0x00, 0xC1, 0x81, 0x40} ; 


const u8 auchCRCLo[] = { 
0x00, 0xC0, 0xC1, 0x01, 0xC3, 0x03, 0x02, 0xC2, 0xC6, 0x06,0x07, 0xC7, 0x05, 0xC5, 0xC4, 0x04, 0xCC, 0x0C, 0x0D, 0xCD, 
0x0F, 0xCF, 0xCE, 0x0E, 0x0A, 0xCA, 0xCB, 0x0B, 0xC9, 0x09,0x08, 0xC8, 0xD8, 0x18, 0x19, 0xD9, 0x1B, 0xDB, 0xDA, 0x1A, 
0x1E, 0xDE, 0xDF, 0x1F, 0xDD, 0x1D, 0x1C, 0xDC, 0x14, 0xD4,0xD5, 0x15, 0xD7, 0x17, 0x16, 0xD6, 0xD2, 0x12, 0x13, 0xD3, 
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0x44, 0x84, 0x85, 0x45, 0x87, 0x47, 0x46, 0x86, 0x82, 0x42,0x43, 0x83, 0x41, 0x81, 0x80, 0x40} ;


//crc16校验
u16 crc16(u8 *puchMsg, u16 usDataLen) 
{ 
	u8 uchCRCHi = 0xFF ; 
	u8 uchCRCLo = 0xFF ; 
	u32 uIndex ; 
	while (usDataLen--) 
	{ 
		uIndex = uchCRCHi ^ *puchMsg++ ; 
		uchCRCHi = uchCRCLo ^ auchCRCHi[uIndex] ; 
		uchCRCLo = auchCRCLo[uIndex] ; 
	} 
	return (uchCRCHi << 8 | uchCRCLo) ; 
}//uint16 crc16(uint8 *puchMsg, uint16 usDataLen)



/*
*   作用：打包命令
*
*/
void construct_rtu_frm ( u8 *dst_buf,u8 *src_buf,u8 lenth)
{
    unsigned short  crc_tmp; //
    crc_tmp = crc16(src_buf, lenth);	
    *(src_buf+lenth) = crc_tmp >> 8 ;
    *(src_buf+lenth+1) = crc_tmp & 0xff;
    lenth++;
    lenth++;
    while ( lenth--)//赋值
    {
       *dst_buf = *src_buf;
       dst_buf++;
       src_buf++;     
    }
}



/*
*   作用：读保持寄存器 03
*   参数：从机地址、缓存区起始地址、从机寄存器起始地址、要读取寄存器的长度
*/
u16  rtu_read_hldreg ( u8 board_adr,u8 *com_buf,u16 start_address,u16 lenth) //03
{
    unsigned char tmp[32], tmp_lenth;   
    tmp[0] = board_adr;//设备地址
    tmp[1] = READ_HLD_REG;//功能号
    tmp[2] = HI(start_address);//起始地址高位
    tmp[3] = LOW(start_address);
    tmp[4] = HI(lenth);//寄存器数量
    tmp[5] = LOW(lenth);
    tmp_lenth = 6;
    construct_rtu_frm ( com_buf,tmp,tmp_lenth);
	sendCount2=8;
	beginSend3();//发送封装后的东西
    return 8;//为了防止编译器报错//？？
}


/*
*   作用：写保持寄存器 06
*   参数：从机地址、缓存区、起始地址、写入值
*/
u16 rtu_set_hldreg( u8 board_adr,u8 *com_buf, u16 start_address, u16 value ) //06
{
    unsigned char tmp[32], tmp_lenth;   
    tmp[0] = board_adr;
    tmp[1] = SET_HLD_REG;
    tmp[2] = HI(start_address);
    tmp[3] = LOW(start_address);
    tmp[4] = HI(value);
    tmp[5] = LOW(value);  
    tmp_lenth = 6;
    construct_rtu_frm ( com_buf, tmp, tmp_lenth);
	sendCount2=8;
	beginSend3();
    return 8 ;
}



/*
*   作用：解析函数(校验、区分不同功能码)
*   参数：解析后数据存放、接收缓存区、起始地址、长度(校验位数)(需要校验的长度起始位+数据段+停止位=10)
*/
int rtu_data_anlys( u16  *dest_p, u8 *source_p, u16 data_start_address, u16 fr_lenth)//rtu 接收分析//
{
    u16 crc_result, crc_tmp;
    u8 tmp1, tmp2, shift;  
	crc_tmp = *(source_p + fr_lenth-2); // crc  第一字节//
 	crc_tmp = crc_tmp * 256 + *( source_p+fr_lenth-1); // CRC 值// 
	crc_result = crc16(source_p, fr_lenth-2); // 计算CRC 值
	
    if ( crc_tmp == crc_result ) // CRC 校验正确//
    {   
        printf("\r\n校验正确\r\n");
		switch ( *(source_p+1) ) // 功能码//
		{
		   case READ_COIL:                   //读取继电器状态//
               for ( tmp1=0; tmp1<*( source_p+2); tmp1++)
               {
                    shift = 1;
                    for ( tmp2=0; tmp2<8; tmp2++)
                    { 
                         *(dest_p+data_start_address+tmp1*8+tmp2) = shift & *( source_p+3);
                         *( source_p+3) >>= 1;          
                    }
               }
		   break;
		   case READ_DI: //读取开关量输入//
               for ( tmp1=0; tmp1<*( source_p+2); tmp1++)
               {
                    shift = 1;
                    for (tmp2=0; tmp2<8; tmp2 ++)
                    { 
                        *(dest_p+data_start_address+tmp1*8+tmp2) = shift & *( source_p+3);
                        *( source_p+3)>>=1;             
                    }
               }
		   break;
		   case READ_HLD_REG:  //读取保持寄存器//
               printf("\r\n解析03命令\r\n");
               for ( tmp1=0; tmp1<*( source_p+2); tmp1+=2)
               {
                    //relay17_he;
                    *(dest_p + data_start_address+ tmp1/2)= *( source_p+tmp1+3)*256 +  *( source_p+tmp1+4) ;
                    //relay17_he;        
               }
		   break ;
		   case 4:      //读取模拟量输入//
               for ( tmp1=0; tmp1<*( source_p+2); tmp1+=2)
               {
                    *(dest_p + data_start_address+ tmp1/2) = *( source_p+tmp1+3)*256 +  *( source_p+tmp1+4) ;      
               }
		   break;
		   case PROTOCOL_EXCEPTION:
                return -1*PROTOCOL_ERR;     //整数转换导致类型变化的迹象
		   //break;
		   default:
		   return -1*PROTOCOL_ERR;		//整数转换导致类型变化的迹象
		   // break;
		}
		receCount2=0;//收到信息计数器清零
	}
    else
    {
        printf("\r\n校验失败\r\n");
        receCount2=0;//收到信息计数器清零
        return -1*PROTOCOL_ERR;
    }
	return 0;	
}



//从机地址、从机寄存器起始地址、寄存器长度、缓存数据的地址
void modbus_master_read(uint8_t slaveraddr,u16 start_address,u16 lenth,uint16_t * save_buff)   
{
    rtu_read_hldreg(slaveraddr,sendBuf2,start_address,lenth);  
    delay_ms(200);//确保接收完成
//    printf("\nmodbus_com_over=%d,USART_RX_BUF=%d\n",modbus_com2_over,USART3_RX_BUF[0]);
//    printf("\r\n");
//    for(int i = 0;i<10;i++)
    //printf(" %02x ",USART3_RX_BUF[i]);
    if(modbus_com2_over ==2&&USART3_RX_BUF[0] == slaveraddr)//上次发送地址的回文
    {
        modbus_com2_over = 0;
        if( -1 == rtu_data_anlys(save_buff,USART3_RX_BUF,0,10))//校验等出错
        {
            receCount2=0;
            memset(USART3_RX_BUF,0,sizeof(USART3_RX_BUF));//清空缓存
            memset(save_buff,0,lenth); 
        }                    
    }
    else if(modbus_com2_over!=2 || USART3_RX_BUF[0] != slaveraddr)
    {       
        modbus_com2_over = 0;
        receCount2=0;
        memset(USART3_RX_BUF,0,sizeof(USART3_RX_BUF));//清空缓存
        memset(save_buff,0,lenth);
    }
}










